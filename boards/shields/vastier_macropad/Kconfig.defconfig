## boards/shields/vastier_macropad/Kconfig.defconfig
```kconfig
if SHIELD_VASTIER_MACROPAD

config ZMK_KEYBOARD_NAME
    default "Vastier-MacroPad"

config ZMK_SPLIT
    default n

config EC11
    default y

endif
```

## boards/shields/vastier_macropad/Kconfig.shield
```kconfig
config SHIELD_VASTIER_MACROPAD
    def_bool $(shields_list_contains,vastier-macropad)
```
